/*
================================================================
 MEDRAS - AMBULANCE CONTROLLER
 FILE : 01_Ambulance.ino
 DEVICE: ESP32 #1
 ID    : AMB_001
================================================================

 FINAL RESPONSIBILITIES
 ----------------------------------------------------------------
 1. Receive emergency assignment from MEDRAS backend through MQTT.
 2. Loud/repeated emergency alert and 10-second response countdown.
 3. If no response, provide a SECOND 10-second response window.
 4. After second timeout, ask backend to reassign the emergency.
 5. Accept / Reject from physical buttons OR dashboard commands.
 6. After acceptance publish live GPS/data every second.
 7. Publish patient-location, pickup, hospital-arrival and completion events.
 8. Priority is allowed only when a patient is onboard.
 9. Priority activates BLE ambulance beacon.
10. Backend/junctions coordinate Green Corridor; junction uses BLE ~1 m.
11. Publish ETA/distance fields supplied by backend.
12. Publish SMS/call request/status information supplied by backend.
13. Automatically reconnect Wi-Fi and MQTT.
14. ESP32 device communication uses MQTT.
    Dashboards use HTTP/WebSocket through the backend.

 COMPONENTS USED
 ----------------------------------------------------------------
 1. ESP32 DevKit
 2. NEO-6M GPS Module
 3. SIM900A on this ambulance ESP32 can send SMS/place calls when the backend
    supplies the recipient number from its database. ESP32 #8 can remain a
    separate central gateway for other devices/workflows.
 4. 16x2 I2C LCD
 5. Buzzer
 6. Accept Push Button
 7. Reject Push Button
 8. Ambulance Priority Button
 9. Built-in ESP32 BLE (ambulance proximity beacon)
 10. Wi-Fi connectivity (ESP32 built-in)
 11. MQTT communication (ESP32 built-in Wi-Fi)
 12. SIM900A GSM module dedicated to this ambulance (separate suitable supply)
 13. Jumper wires and common GND

 LOCATION-LINK NOTIFICATION
 ----------------------------------------------------------------
 Every ambulance notification generated by this ESP32 includes:
 - A LIVE TRACKING LINK handled by the MEDRAS backend.
 - A CURRENT GPS LOCATION LINK using the ambulance coordinates.
 The backend/GSM Gateway should forward these links in SMS.
 Replace LIVE_TRACKING_BASE_URL with the real deployed MEDRAS
 tracking URL.

 FINAL AUDIT COVERAGE
 ----------------------------------------------------------------
 A. Emergency assignment + first 10-second alert       : COVERED
 B. Second 10-second alert window                     : COVERED
 C. Reassignment request after two timeouts            : COVERED
 D. Physical Accept / Reject                           : COVERED
 E. Dashboard Accept / Reject commands                 : COVERED
 F. Live GPS/data publication every 1 second            : COVERED
 G. Patient reached / pickup / hospital events          : COVERED
 H. Patient-onboard safety gate for priority            : COVERED
 I. Priority button + dashboard priority                : COVERED
 J. BLE ambulance beacon during priority                : COVERED
 K. Backend/junction Green Corridor coordination        : COVERED
 L. ETA and distance values from backend                : COVERED
 M. Backend-resolved local SIM900A SMS/calls             : ADDED (backend commands required)
 N. Location links in ambulance messages                : COVERED
 O. Wi-Fi and MQTT automatic reconnection               : COVERED
 P. LCD status + countdown                              : COVERED
 Q. GPS speed/satellites/HDOP                           : COVERED
 R. Hospital selected / hospital ready                  : COVERED
 S. Green Corridor active / stop / junction update      : COVERED
 T. Emergency cancel / complete                         : COVERED
 U. MQTT command/event telemetry                         : COVERED
 V. Dashboard live-tracking fields                      : COVERED
 W. Current Google Maps GPS snapshot link               : COVERED
 X. BLE beacon identity contains ambulance/emergency ID : COVERED
 Y. Backend remains responsible for routing, assignment,
    recipient resolution and dashboard WebSocket updates : BACKEND RESPONSIBILITY

 IMPORTANT GSM NOTE
 ----------------------------------------------------------------
 This version controls a separate SIM900A connected to ESP32 #1. The backend
 still owns all phone numbers: it resolves patient/family/hospital numbers
 from its database and sends GSM_SEND_SMS / GSM_CALL commands containing the
 selected number to this ambulance over authenticated MQTT. No phone number is
 hard-coded here. Configure the backend so these ambulance-local jobs are NOT
 also duplicated through ESP32 #8. ESP32 #8 may continue serving other devices.

 Vehicle and Patient/User notifications are generated by their own
 device/backend workflows. This ambulance file supplies the same
 location-link fields for all ambulance-originated notifications.
================================================================
*/

#include <WiFi.h>
#include <PubSubClient.h>
#include <ArduinoJson.h>
#include <Wire.h>
#include <LiquidCrystal_I2C.h>
#include <TinyGPSPlus.h>
#include <NimBLEDevice.h>
// ================= MEDRAS AUTO SERVER DISCOVERY =================
// Backend broadcasts MEDRAS_SERVER=<current-laptop-ip>:1883 on UDP 4210.
#include <WiFiUdp.h>

// ============================================================
// MEDRAS HTTP + WEBSOCKET CLIENTS (in addition to MQTT)
// Backend contract expected by this firmware:
//   HTTP POST http://<discovered-server-ip>:5000/api/iot/telemetry
//   WebSocket ws://<discovered-server-ip>:8000/ws/iot
// The backend must implement these endpoints; firmware presence
// alone does not create the server endpoints.
// ============================================================
#include <HTTPClient.h>
#include <WebSocketsClient.h>

WebSocketsClient medrasWebSocket;
bool medrasWebSocketStarted = false;
bool medrasWebSocketConnected = false;
String medrasTransportHost = "";
unsigned long medrasLastHttpPost = 0;
unsigned long medrasLastWebSocketHeartbeat = 0;
const uint16_t MEDRAS_HTTP_PORT = 8000;
const uint16_t MEDRAS_WEBSOCKET_PORT = 8000;
const unsigned long MEDRAS_HTTP_INTERVAL_MS = 10000UL;
const unsigned long MEDRAS_WS_HEARTBEAT_MS = 5000UL;






WiFiUDP medrasDiscoveryUDP;
bool medrasDiscoveryUdpStarted = false; // UDP must not be used before Wi-Fi is up.
IPAddress medrasMQTTServerIP(0, 0, 0, 0);
uint16_t medrasMQTTServerPort = 1883;
bool medrasServerDiscovered = false;

// Static fallback from the fixed-IP version.
// Auto-discovery is preferred; this is used only if discovery is unavailable.
const char* MQTT_FALLBACK_SERVER = "10.17.229.46";
const uint16_t MQTT_FALLBACK_PORT = 1883;
const unsigned long DISCOVERY_FALLBACK_DELAY = 15000UL;
unsigned long discoveryStartMillis = 0;
bool usingFallbackServer = false;

void medrasDiscoveryTask() {
  // WiFiUDP uses the network stack; do not call it until begin() succeeds
  // after Wi-Fi has connected. This avoids invalid FreeRTOS queue/semaphore use.
  if (!medrasDiscoveryUdpStarted || WiFi.status() != WL_CONNECTED) return;
  int packetSize = medrasDiscoveryUDP.parsePacket();
  if (packetSize <= 0) return;
  char buf[128];
  int n = medrasDiscoveryUDP.read(buf, sizeof(buf) - 1);
  if (n <= 0) return;
  buf[n] = '\0';
  String msg(buf);
  msg.trim();
  if (!msg.startsWith("MEDRAS_SERVER=")) return;
  String value = msg.substring(14);
  int colon = value.indexOf(':');
  String ipText = colon >= 0 ? value.substring(0, colon) : value;
  uint16_t port = colon >= 0 ? (uint16_t)value.substring(colon + 1).toInt() : 1883;
  IPAddress parsed;
  if (!parsed.fromString(ipText)) return;
  bool changed = !medrasServerDiscovered || parsed != medrasMQTTServerIP || port != medrasMQTTServerPort;
  medrasMQTTServerIP = parsed;
  medrasMQTTServerPort = port;
  medrasServerDiscovered = true;
  usingFallbackServer = false;
  if (changed) {
    Serial.print("[MEDRAS] Server discovered: ");
    Serial.print(medrasMQTTServerIP);
    Serial.print(":");
    Serial.println(medrasMQTTServerPort);
  }
}


// ========================= DEVICE =============================

const char* DEVICE_ID       = "ESP32_AMB_001";
const char* AMBULANCE_ID    = "AMB_001";
const char* BLE_DEVICE_NAME = "MEDRAS_AMB_AMB_001";

// ========================= WIFI ================================

const char* WIFI_SSID = "OPPO Reno7 Pro 5G";
const char* WIFI_PASS = "Pass@word";

// Recipient phone numbers are intentionally NOT stored in firmware.
// The backend resolves ambulance/patient/family numbers from its database.

// ========================= MQTT ================================

const char* MQTT_SERVER = MQTT_FALLBACK_SERVER; // Used only as 15-sec fallback.
const uint16_t MQTT_PORT = MQTT_FALLBACK_PORT;

const char* TOPIC_DATA      = "medras/ambulance/data";
const char* TOPIC_STATUS    = "medras/ambulance/status";
const char* TOPIC_COMMAND   = "medras/ambulance/command";
const char* TOPIC_EMERGENCY = "medras/ambulance/emergency";

// =================================================================
// LIVE LOCATION LINKS
// =================================================================
// Replace this with the real MEDRAS backend URL used by the
// User / Family / Ambulance / Hospital dashboards.
// Example: https://medras.example.com/track
const char* LIVE_TRACKING_BASE_URL = "https://YOUR_MEDRAS_DOMAIN/track";

// ========================= PINS ================================
// Pin map: LCD SDA21/SCL22; Accept GPIO32; Reject GPIO33; Priority GPIO25; Buzzer GPIO4.

#define LCD_SDA 21
#define LCD_SCL 22

#define GPS_RX 16
#define GPS_TX 17

#define ACCEPT_BUTTON  32
#define REJECT_BUTTON  33
#define PRIORITY_BUTTON 25

#define BUZZER_PIN 4

// Separate SIM900A connected directly to ambulance ESP32 #1.
// SIM900A TXD -> ESP32 GPIO27 (GSM RX); SIM900A RXD <- ESP32 GPIO26 (GSM TX).
// Use a suitable external supply for the specific GSM board; share GND.
#define GSM_TX_PIN 26
#define GSM_RX_PIN 27

// ========================= OBJECTS =============================

WiFiClient wifiClient;
PubSubClient mqtt(wifiClient);

void medrasWebSocketEvent(WStype_t type, uint8_t * payload, size_t length) {
  switch (type) {
    case WStype_CONNECTED:
      medrasWebSocketConnected = true;
      Serial.println("[MEDRAS WS] Connected to backend");
      break;
    case WStype_DISCONNECTED:
      medrasWebSocketConnected = false;
      Serial.println("[MEDRAS WS] Disconnected; auto-reconnect enabled");
      break;
    case WStype_TEXT:
      Serial.print("[MEDRAS WS] Server message: ");
      for (size_t i = 0; i < length; ++i) Serial.print((char)payload[i]);
      Serial.println();
      // Commands that affect emergency/traffic safety must still be
      // validated by the existing MQTT/backend authorization flow.
      break;
    default:
      break;
  }
}

void medrasTransportTask() {
  if (WiFi.status() != WL_CONNECTED) {
    medrasWebSocketConnected = false;
    return;
  }

  // Reconfigure the HTTP/WebSocket target when UDP discovery changes IP.
  if (medrasMQTTServerIP[0] == 0 && medrasMQTTServerIP[1] == 0 &&
      medrasMQTTServerIP[2] == 0 && medrasMQTTServerIP[3] == 0) return;

  String host = medrasMQTTServerIP.toString();
  if (!medrasWebSocketStarted || host != medrasTransportHost) {
    if (medrasWebSocketStarted) medrasWebSocket.disconnect();
    medrasTransportHost = host;
    medrasWebSocket.onEvent(medrasWebSocketEvent);
    medrasWebSocket.setReconnectInterval(5000);
    medrasWebSocket.begin(host.c_str(), MEDRAS_WEBSOCKET_PORT, "/ws/iot");
    medrasWebSocketStarted = true;
    Serial.print("[MEDRAS WS] Target: ws://");
    Serial.print(host);
    Serial.println(":8000/ws/iot");
  }

  medrasWebSocket.loop();

  // HTTP status heartbeat; actual sensor/event data remains on the
  // existing MQTT topics. This endpoint must be implemented server-side.
  unsigned long now = millis();
  if (now - medrasLastHttpPost >= MEDRAS_HTTP_INTERVAL_MS) {
    medrasLastHttpPost = now;
    HTTPClient http;
    String url = String("http://") + host + ":" + MEDRAS_HTTP_PORT + "/api/iot/telemetry";
    if (http.begin(url)) {
      http.setConnectTimeout(1200);
      http.setTimeout(1500);
      http.addHeader("Content-Type", "application/json");
      StaticJsonDocument<256> payload;
      payload["device_id"] = "ESP32_AMB_001";
      payload["transport"] = "HTTP";
      payload["wifi_connected"] = true;
      payload["mqtt_connected"] = mqtt.connected();
      payload["websocket_connected"] = medrasWebSocketConnected;
      payload["uptime_ms"] = now;
      String body;
      serializeJson(payload, body);
      int code = http.POST(body);
      Serial.printf("[MEDRAS HTTP] POST status=%d\n", code);
      http.end();
    }
  }

  if (medrasWebSocketConnected && now - medrasLastWebSocketHeartbeat >= MEDRAS_WS_HEARTBEAT_MS) {
    medrasLastWebSocketHeartbeat = now;
    StaticJsonDocument<192> heartbeat;
    heartbeat["type"] = "device_heartbeat";
    heartbeat["device_id"] = "ESP32_AMB_001";
    heartbeat["mqtt_connected"] = mqtt.connected();
    heartbeat["uptime_ms"] = now;
    String message;
    serializeJson(heartbeat, message);
    medrasWebSocket.sendTXT(message);
  }
}



LiquidCrystal_I2C lcd(0x27, 16, 2);
TinyGPSPlus gps;
HardwareSerial GPSSerial(2);
HardwareSerial GSMSerial(1);

// ========================= TIMERS ==============================

const unsigned long LIVE_INTERVAL       = 1000UL;
const unsigned long LCD_INTERVAL        = 1000UL;
const unsigned long COUNTDOWN_INTERVAL  = 1000UL;
const unsigned long ALERT_BEEP_INTERVAL = 500UL;
const unsigned long WIFI_RETRY_INTERVAL = 5000UL;
const unsigned long MQTT_RETRY_INTERVAL = 3000UL;
const unsigned long BLE_REFRESH_INTERVAL = 1000UL;

// ========================= EMERGENCY ============================

bool emergencyActive = false;
bool emergencyAccepted = false;
bool patientOnBoard = false;
bool priorityActive = false;
bool greenCorridorActive = false;

String emergencyId = "";
String patientId = "";
String emergencySource = "";
String currentPhase = "IDLE";

double patientLat = 0.0;
double patientLon = 0.0;

double hospitalLat = 0.0;
double hospitalLon = 0.0;

String hospitalId = "";
String hospitalName = "";
String currentJunction = "";
String incomingDirection = "";
String outgoingDirection = "";

// Backend-authoritative ETA/distance values.
long etaToPatientSec = -1;
long etaToHospitalSec = -1;
long distanceToPatientM = -1;
long distanceToHospitalM = -1;

// ========================= RESPONSE WINDOW =====================

int assignmentAttempt = 0;
const int MAX_ASSIGNMENT_ATTEMPTS = 2;

bool responseWindowActive = false;
unsigned long responseDeadline = 0;

// ========================= GPS ================================

double latitude = 0.0;
double longitude = 0.0;
double speedKmph = 0.0;
double hdop = 0.0;
uint32_t satellites = 0;
bool gpsFix = false;

// ========================= NOTIFICATIONS =======================

int familySmsSentCount = 0;
int patientSmsSentCount = 0;
int hospitalSmsSentCount = 0;
int totalSmsSentCount = 0;

String lastSmsStatus = "NONE";
String lastCallStatus = "NONE";
String lastNotificationEvent = "NONE";
String lastLcdEvent = "BOOTING";

// ========================= BUTTON ==============================

bool lastAcceptState = HIGH;
bool lastRejectState = HIGH;
bool lastPriorityState = HIGH;

// ========================= LCD ================================

unsigned long lastLivePublish = 0;
unsigned long lastLcdUpdate = 0;
unsigned long lastCountdownTick = 0;
unsigned long lastAlertBeep = 0;
unsigned long lastWifiRetry = 0;
unsigned long lastMqttRetry = 0;
unsigned long lastBleRefresh = 0;

int lcdPage = 0;

// GSM status and call timer. Calls are automatically ended after 20 seconds.
bool localGsmReady = false;
bool localGsmCallActive = false;
unsigned long localGsmCallStartedAt = 0;
const unsigned long LOCAL_GSM_CALL_LIMIT_MS = 20000UL;
String localGsmLastResult = "NOT_INITIALIZED";
String localGsmLastRecipient = "NONE";

// ========================= BLE ================================

NimBLEAdvertising* bleAdvertising = nullptr;

// =================================================================
// UTILITY
// =================================================================

String phaseText() {
  if (!emergencyActive) return "IDLE";
  if (!emergencyAccepted) return "ASSIGNMENT";
  if (!patientOnBoard) return "TO_PATIENT";
  if (priorityActive && greenCorridorActive) return "GREEN_CORRIDOR";
  if (patientOnBoard) return "TO_HOSPITAL";
  return currentPhase;
}

void buzzerOn() {
  digitalWrite(BUZZER_PIN, HIGH);
}

void buzzerOff() {
  digitalWrite(BUZZER_PIN, LOW);
}

void shortBeep() {
  buzzerOn();
  delay(100);
  buzzerOff();
}

void clearEmergencyData() {
  emergencyActive = false;
  emergencyAccepted = false;
  patientOnBoard = false;
  priorityActive = false;
  greenCorridorActive = false;

  emergencyId = "";
  patientId = "";
  emergencySource = "";
  currentPhase = "IDLE";

  patientLat = 0.0;
  patientLon = 0.0;

  hospitalLat = 0.0;
  hospitalLon = 0.0;

  hospitalId = "";
  hospitalName = "";
  currentJunction = "";
  incomingDirection = "";
  outgoingDirection = "";

  etaToPatientSec = -1;
  etaToHospitalSec = -1;
  distanceToPatientM = -1;
  distanceToHospitalM = -1;

  assignmentAttempt = 0;
  responseWindowActive = false;
  responseDeadline = 0;
}

// =================================================================
// GPS
// =================================================================

void readGPS() {
  while (GPSSerial.available()) {
    gps.encode(GPSSerial.read());
  }

  if (gps.location.isValid()) {
    latitude = gps.location.lat();
    longitude = gps.location.lng();
    gpsFix = true;
  }

  if (gps.speed.isValid()) {
    speedKmph = gps.speed.kmph();
  }

  if (gps.satellites.isValid()) {
    satellites = gps.satellites.value();
  }

  if (gps.hdop.isValid()) {
    hdop = gps.hdop.hdop();
  }
}

// =================================================================
// BLE
// =================================================================

void startBLEBeacon() {
  if (!priorityActive || !patientOnBoard || !emergencyActive) {
    stopBLEBeacon();
    return;
  }

  if (!bleAdvertising) {
    NimBLEDevice::init(BLE_DEVICE_NAME);

    NimBLEServer* server = NimBLEDevice::createServer();
    (void)server;

    bleAdvertising = NimBLEDevice::getAdvertising();
  }

  NimBLEAdvertisementData advertisementData;
  advertisementData.setName(BLE_DEVICE_NAME);

  String payload =
    "AMB=" + String(AMBULANCE_ID) +
    ";EMG=" + emergencyId +
    ";PRI=1";

  advertisementData.setManufacturerData(payload.c_str());

  bleAdvertising->setAdvertisementData(advertisementData);
  bleAdvertising->start();

  Serial.println("[BLE] PRIORITY BEACON ON");
}

void stopBLEBeacon() {
  if (bleAdvertising) {
    bleAdvertising->stop();
  }
}

// =================================================================
// MQTT PUBLISH
// =================================================================

void publishJson(const char* topic, JsonDocument& doc) {
  if (!mqtt.connected()) return;

  String payload;
  serializeJson(doc, payload);
  mqtt.publish(topic, payload.c_str());
}

void publishStatus(const char* eventName) {
  JsonDocument doc;

  doc["device_id"] = DEVICE_ID;
  doc["ambulance_id"] = AMBULANCE_ID;
  doc["event"] = eventName;

  doc["wifi_connected"] = (WiFi.status() == WL_CONNECTED);
  doc["mqtt_connected"] = mqtt.connected();
  doc["local_gsm_ready"] = localGsmReady;
  doc["local_gsm_call_active"] = localGsmCallActive;
  doc["local_gsm_last_result"] = localGsmLastResult;

  doc["emergency_active"] = emergencyActive;
  doc["emergency_id"] = emergencyId;
  doc["patient_id"] = patientId;

  doc["emergency_accepted"] = emergencyAccepted;
  doc["patient_onboard"] = patientOnBoard;
  doc["priority_active"] = priorityActive;
  doc["green_corridor_active"] = greenCorridorActive;

  doc["assignment_attempt"] = assignmentAttempt;
  doc["response_window_active"] = responseWindowActive;

  doc["current_phase"] = phaseText();
  doc["current_junction"] = currentJunction;

  publishJson(TOPIC_STATUS, doc);
}

void publishLiveData() {
  JsonDocument doc;

  doc["device_id"] = DEVICE_ID;
  doc["ambulance_id"] = AMBULANCE_ID;

  doc["emergency_active"] = emergencyActive;
  doc["emergency_id"] = emergencyId;
  doc["patient_id"] = patientId;
  doc["emergency_source"] = emergencySource;

  doc["assignment_attempt"] = assignmentAttempt;
  doc["response_window_active"] = responseWindowActive;

  doc["emergency_accepted"] = emergencyAccepted;
  doc["patient_onboard"] = patientOnBoard;

  doc["priority_active"] = priorityActive;
  doc["green_corridor_active"] = greenCorridorActive;

  doc["current_phase"] = phaseText();
  doc["current_junction"] = currentJunction;

  // Ambulance GPS.
  doc["latitude"] = latitude;
  doc["longitude"] = longitude;
  doc["speed_kmph"] = speedKmph;
  doc["satellites"] = satellites;
  doc["hdop"] = hdop;
  doc["gps_fix"] = gpsFix;
  doc["local_gsm_ready"] = localGsmReady;
  doc["local_gsm_call_active"] = localGsmCallActive;
  doc["local_gsm_last_result"] = localGsmLastResult;

  // Patient location.
  doc["patient_lat"] = patientLat;
  doc["patient_lon"] = patientLon;

  // Hospital.
  doc["hospital_id"] = hospitalId;
  doc["hospital_name"] = hospitalName;
  doc["hospital_lat"] = hospitalLat;
  doc["hospital_lon"] = hospitalLon;

  // Backend calculated navigation values.
  doc["distance_to_patient_m"] = distanceToPatientM;
  doc["distance_to_hospital_m"] = distanceToHospitalM;
  doc["eta_to_patient_sec"] = etaToPatientSec;
  doc["eta_to_hospital_sec"] = etaToHospitalSec;

  doc["incoming_direction"] = incomingDirection;
  doc["outgoing_direction"] = outgoingDirection;

  // Notification information.
  doc["family_sms_sent_count"] = familySmsSentCount;
  doc["patient_sms_sent_count"] = patientSmsSentCount;
  doc["hospital_sms_sent_count"] = hospitalSmsSentCount;
  doc["total_sms_sent_count"] = totalSmsSentCount;
  doc["last_sms_status"] = lastSmsStatus;
  doc["last_call_status"] = lastCallStatus;
  doc["last_notification_event"] = lastNotificationEvent;

  // Dashboard can use this link directly for live tracking.
  doc["live_tracking_link"] = buildLiveTrackingLink();
  doc["current_location_link"] = buildCurrentLocationLink();

  doc["wifi_connected"] = (WiFi.status() == WL_CONNECTED);
  doc["mqtt_connected"] = mqtt.connected();

  doc["timestamp_ms"] = millis();

  publishJson(TOPIC_DATA, doc);
}

// =================================================================
// EMERGENCY EVENT
// =================================================================

void publishEmergencyEvent(const char* eventName) {
  lastLcdEvent = String(eventName);
  JsonDocument doc;

  doc["device_id"] = DEVICE_ID;
  doc["ambulance_id"] = AMBULANCE_ID;
  doc["event"] = eventName;

  doc["emergency_id"] = emergencyId;
  doc["patient_id"] = patientId;
  doc["emergency_source"] = emergencySource;

  doc["latitude"] = latitude;
  doc["longitude"] = longitude;
  doc["speed_kmph"] = speedKmph;
  doc["satellites"] = satellites;
  doc["hdop"] = hdop;

  doc["patient_lat"] = patientLat;
  doc["patient_lon"] = patientLon;

  doc["hospital_id"] = hospitalId;
  doc["hospital_name"] = hospitalName;
  doc["hospital_lat"] = hospitalLat;
  doc["hospital_lon"] = hospitalLon;

  doc["patient_onboard"] = patientOnBoard;
  doc["priority_active"] = priorityActive;
  doc["green_corridor_active"] = greenCorridorActive;

  doc["current_junction"] = currentJunction;
  doc["eta_to_patient_sec"] = etaToPatientSec;
  doc["eta_to_hospital_sec"] = etaToHospitalSec;

  // Location links are included with every ambulance event so the
  // backend/GSM Gateway can place them in every notification.
  doc["live_tracking_link"] = buildLiveTrackingLink();
  doc["current_location_link"] = buildCurrentLocationLink();
  doc["location_message"] =
    String("Live Location: ") + buildLiveTrackingLink() +
    "\nCurrent GPS: " + buildCurrentLocationLink();

  publishJson(TOPIC_EMERGENCY, doc);
}

// =================================================================
// LOCATION LINKS
// =================================================================

String buildLiveTrackingLink() {
  // The backend uses emergency_id + ambulance_id to open the
  // live ambulance tracking page and stream the latest GPS data.
  if (emergencyId.length() == 0) {
    return String(LIVE_TRACKING_BASE_URL) +
           "?ambulance_id=" + String(AMBULANCE_ID);
  }

  return String(LIVE_TRACKING_BASE_URL) +
         "?emergency_id=" + emergencyId +
         "&ambulance_id=" + String(AMBULANCE_ID);
}

String buildCurrentLocationLink() {
  if (!gpsFix) {
    return "GPS location not available yet";
  }

  // Google Maps point link. This is the current GPS position at the
  // time the notification is generated; the LIVE_TRACKING link above
  // is the continuously updated tracking link.
  return String("https://www.google.com/maps/search/?api=1&query=") +
         String(latitude, 6) + "," + String(longitude, 6);
}

String addLocationLinksToMessage(String message) {
  String result = message;
  result += "\nLive Location: ";
  result += buildLiveTrackingLink();
  result += "\nCurrent GPS: ";
  result += buildCurrentLocationLink();
  return result;
}

// ================= LOCAL SIM900A GSM ==============================
// Backend is the source of recipient phone numbers. These functions only
// accept a phone number delivered in a trusted MQTT command from the backend.

bool gsmWaitFor(const char* token, unsigned long timeoutMs) {
  String response;
  unsigned long started = millis();
  while (millis() - started < timeoutMs) {
    while (GSMSerial.available()) {
      char c = (char)GSMSerial.read();
      response += c;
      if (response.indexOf(token) >= 0) {
        Serial.print("[GSM] "); Serial.println(response);
        return true;
      }
      if (response.indexOf("ERROR") >= 0 || response.indexOf("+CMS ERROR") >= 0) {
        Serial.print("[GSM] "); Serial.println(response);
        return false;
      }
      if (response.length() > 500) response.remove(0, 250);
    }
    delay(2);
  }
  Serial.print("[GSM] Timeout waiting for: "); Serial.println(token);
  return false;
}

bool gsmCommand(const String& command, const char* expected, unsigned long timeoutMs = 2500UL) {
  while (GSMSerial.available()) GSMSerial.read();
  GSMSerial.println(command);
  Serial.print("[GSM TX] "); Serial.println(command);
  return gsmWaitFor(expected, timeoutMs);
}

bool validPhoneNumber(String number) {
  number.trim();
  if (number.length() < 8 || number.length() > 16) return false;
  int start = (number[0] == '+') ? 1 : 0;
  if (start == 1 && number.length() < 9) return false;
  for (int i = start; i < number.length(); i++) {
    if (!isDigit(number[i])) return false;
  }
  return true;
}

void publishLocalGsmResult(const char* action, const String& recipientType,
                           const String& result, const String& detail = "") {
  localGsmLastResult = result;
  localGsmLastRecipient = recipientType;
  lastLcdEvent = "GSM " + result;
  JsonDocument status;
  status["device_id"] = DEVICE_ID;
  status["ambulance_id"] = AMBULANCE_ID;
  status["emergency_id"] = emergencyId;
  status["event"] = "LOCAL_GSM_RESULT";
  status["action"] = action;
  status["recipient_type"] = recipientType;
  status["result"] = result;
  status["detail"] = detail;
  status["gsm_ready"] = localGsmReady;
  publishJson(TOPIC_STATUS, status);
}

void initializeLocalGsm() {
  GSMSerial.begin(9600, SERIAL_8N1, GSM_RX_PIN, GSM_TX_PIN);
  delay(300);
  localGsmReady = gsmCommand("AT", "OK", 3000UL);
  if (localGsmReady) {
    gsmCommand("ATE0", "OK", 2000UL);
    gsmCommand("AT+CMGF=1", "OK", 2000UL);
    gsmCommand("AT+CLIP=1", "OK", 2000UL);
    localGsmLastResult = "READY";
  } else {
    localGsmLastResult = "NO_MODEM_RESPONSE";
  }
  Serial.print("[GSM] Local SIM900A: "); Serial.println(localGsmLastResult);
}

bool localGsmSendSms(String number, String messageText, String recipientType) {
  if (!validPhoneNumber(number)) {
    publishLocalGsmResult("SMS", recipientType, "REJECTED_BAD_NUMBER");
    return false;
  }
  if (!localGsmReady && !gsmCommand("AT", "OK", 2000UL)) {
    localGsmReady = false;
    publishLocalGsmResult("SMS", recipientType, "MODEM_NOT_READY");
    return false;
  }
  localGsmReady = true;
  if (!gsmCommand("AT+CMGF=1", "OK", 2000UL)) {
    publishLocalGsmResult("SMS", recipientType, "TEXT_MODE_FAILED");
    return false;
  }
  GSMSerial.print("AT+CMGS=\""); GSMSerial.print(number); GSMSerial.println("\"");
  if (!gsmWaitFor(">", 5000UL)) {
    publishLocalGsmResult("SMS", recipientType, "NO_PROMPT");
    return false;
  }
  GSMSerial.print(messageText);
  GSMSerial.write((uint8_t)26); // Ctrl+Z submits SMS.
  bool ok = gsmWaitFor("+CMGS:", 20000UL);
  if (ok) ok = gsmWaitFor("OK", 5000UL);
  publishLocalGsmResult("SMS", recipientType, ok ? "SENT_TO_MODEM" : "SEND_FAILED");
  if (ok) {
    totalSmsSentCount++;
    if (recipientType == "FAMILY") familySmsSentCount++;
    else if (recipientType == "PATIENT") patientSmsSentCount++;
    else if (recipientType == "HOSPITAL") hospitalSmsSentCount++;
  }
  return ok;
}

bool localGsmStartCall(String number, String recipientType) {
  if (!validPhoneNumber(number)) {
    publishLocalGsmResult("CALL", recipientType, "REJECTED_BAD_NUMBER");
    return false;
  }
  if (localGsmCallActive) {
    publishLocalGsmResult("CALL", recipientType, "BUSY_CALL_ACTIVE");
    return false;
  }
  if (!localGsmReady && !gsmCommand("AT", "OK", 2000UL)) {
    localGsmReady = false;
    publishLocalGsmResult("CALL", recipientType, "MODEM_NOT_READY");
    return false;
  }
  localGsmReady = true;
  while (GSMSerial.available()) GSMSerial.read();
  GSMSerial.print("ATD"); GSMSerial.print(number); GSMSerial.println(";");
  delay(300);
  // ATD commonly returns OK even before network call setup is confirmed.
  if (!gsmWaitFor("OK", 3000UL)) {
    publishLocalGsmResult("CALL", recipientType, "DIAL_COMMAND_FAILED");
    return false;
  }
  localGsmCallActive = true;
  localGsmCallStartedAt = millis();
  publishLocalGsmResult("CALL", recipientType, "DIALING_MAX_20S");
  return true;
}

void localGsmHangup(const String& reason = "TIME_LIMIT") {
  if (!localGsmCallActive) return;
  gsmCommand("ATH", "OK", 3000UL);
  localGsmCallActive = false;
  publishLocalGsmResult("CALL", localGsmLastRecipient, "ENDED_" + reason);
}

void handleLocalGsmCommand(JsonDocument& doc, const char* command) {
  String number = doc["phone_number"] | "";
  String recipientType = doc["recipient_type"] | "UNKNOWN";
  String messageText = doc["message"] | "MEDRAS emergency notification";
  if (messageText.length() > 500) messageText.remove(500);

  // Only backend-generated commands should contain phone_number. Backend
  // must look up the number by patient/family/hospital ID in its database.
  if (strcmp(command, "GSM_SEND_SMS") == 0) {
    localGsmSendSms(number, messageText, recipientType);
  } else if (strcmp(command, "GSM_CALL") == 0) {
    localGsmStartCall(number, recipientType);
  } else if (strcmp(command, "GSM_HANGUP") == 0) {
    localGsmHangup("BACKEND_COMMAND");
  }
}

// ========================= GSM ROUTING ARCHITECTURE ===============
// SMS/call requests ask the backend to resolve a recipient in its database.
// Backend replies with GSM_SEND_SMS or GSM_CALL containing that selected
// number, which is executed by this ambulance-local SIM900A. Never hardcode
// recipient numbers in this firmware.

// =================================================================
// CALL / SMS REQUEST
// =================================================================
// The ambulance asks the backend for recipient resolution; backend then
// sends a targeted command back to this ESP32 for its local SIM900A.

void requestCallToServer(String purpose) {
  JsonDocument doc;

  doc["device_id"] = DEVICE_ID;
  doc["ambulance_id"] = AMBULANCE_ID;
  doc["emergency_id"] = emergencyId;
  doc["action"] = "CALL_REQUEST";
  doc["execution_device"] = "AMBULANCE_LOCAL_GSM";
  doc["purpose"] = purpose;
  doc["live_tracking_link"] = buildLiveTrackingLink();
  doc["current_location_link"] = buildCurrentLocationLink();
  doc["latitude"] = latitude;
  doc["longitude"] = longitude;
  doc["gps_fix"] = gpsFix;

  publishJson(TOPIC_EMERGENCY, doc);
}

void requestSmsToServer(String recipientType, String message) {
  JsonDocument doc;

  doc["device_id"] = DEVICE_ID;
  doc["ambulance_id"] = AMBULANCE_ID;
  doc["emergency_id"] = emergencyId;
  doc["action"] = "SMS_REQUEST";
  doc["execution_device"] = "AMBULANCE_LOCAL_GSM";
  doc["recipient_type"] = recipientType;
  doc["message"] = addLocationLinksToMessage(message);
  doc["live_tracking_link"] = buildLiveTrackingLink();
  doc["current_location_link"] = buildCurrentLocationLink();
  doc["latitude"] = latitude;
  doc["longitude"] = longitude;
  doc["gps_fix"] = gpsFix;

  // No phone number is embedded in firmware. The backend resolves
  // recipientType (PATIENT/FAMILY/HOSPITAL/AMBULANCE) in its database and
  // sends GSM_SEND_SMS back to this ambulance with the selected number.
  publishJson(TOPIC_EMERGENCY, doc);
}

// =================================================================
// RESPONSE WINDOW
// =================================================================

void startResponseWindow(int attempt) {
  assignmentAttempt = attempt;
  responseWindowActive = true;
  responseDeadline = millis() + 10000UL;
  lastLcdEvent = (attempt == 1) ? "10S COUNTDOWN 1" : "10S COUNTDOWN 2";

  currentPhase = (attempt == 1)
                   ? "FIRST_RESPONSE_WINDOW"
                   : "SECOND_RESPONSE_WINDOW";

  lcdPage = 0;

  Serial.print("[EMERGENCY] Response attempt ");
  Serial.println(assignmentAttempt);

  publishEmergencyEvent(
    attempt == 1
      ? "AMBULANCE_ALERT_FIRST_10_SEC"
      : "AMBULANCE_ALERT_SECOND_10_SEC"
  );
}

void rejectCurrentEmergency(const char* source) {
  if (!emergencyActive || emergencyAccepted) return;
  lastLcdEvent = "AMBULANCE REJECTED";

  responseWindowActive = false;
  currentPhase = "REJECTED";

  JsonDocument doc;
  doc["device_id"] = DEVICE_ID;
  doc["ambulance_id"] = AMBULANCE_ID;
  doc["emergency_id"] = emergencyId;
  doc["event"] = "AMBULANCE_REJECTED";
  doc["source"] = source;
  doc["assignment_attempt"] = assignmentAttempt;

  // Rejection is also a notification event, so include the same
  // live-tracking and current-GPS links used by every other event.
  doc["live_tracking_link"] = buildLiveTrackingLink();
  doc["current_location_link"] = buildCurrentLocationLink();
  doc["location_message"] =
    String("Live Location: ") + buildLiveTrackingLink() +
    "\nCurrent GPS: " + buildCurrentLocationLink();

  publishJson(TOPIC_EMERGENCY, doc);

  requestCallToServer("AMBULANCE_REJECTED");

  requestSmsToServer(
    "BACKEND",
    "Ambulance rejected emergency " + emergencyId
  );
}

void acceptEmergency(const char* source) {
  if (!emergencyActive || emergencyAccepted) return;
  if (!responseWindowActive) return;
  lastLcdEvent = "EMERGENCY ACCEPTED";

  responseWindowActive = false;
  emergencyAccepted = true;

  currentPhase = "ACCEPTED";

  publishEmergencyEvent("AMBULANCE_ACCEPTED");

  requestCallToServer("AMBULANCE_ACCEPTED");

  requestSmsToServer(
    "HOSPITAL",
    "Ambulance accepted emergency " + emergencyId
  );

  requestSmsToServer(
    "PATIENT",
    "Ambulance accepted your emergency " + emergencyId
  );

  requestSmsToServer(
    "FAMILY",
    "Ambulance accepted emergency " + emergencyId
  );

  startBLEBeacon();

  Serial.print("[AMBULANCE] Accepted by ");
  Serial.println(source);
}

// =================================================================
// PRIORITY
// =================================================================

void activatePriority(const char* source) {
  if (!emergencyActive) { lastLcdEvent = "NO ACTIVE EMG"; return; }

  if (!emergencyAccepted) {
    lastLcdEvent = "PRIORITY REJECTED";
    Serial.println("[PRIORITY] Rejected: ambulance not accepted.");
    publishEmergencyEvent("PRIORITY_REJECTED_NOT_ACCEPTED");
    return;
  }

  if (!patientOnBoard) {
    lastLcdEvent = "PRIORITY NO PATIENT";
    Serial.println("[PRIORITY] Rejected: patient is not onboard.");
    publishEmergencyEvent("PRIORITY_REJECTED_PATIENT_NOT_ONBOARD");
    return;
  }

  if (!mqtt.connected()) {
    lastLcdEvent = "PRIORITY NO SERVER";
    Serial.println("[PRIORITY] Rejected: server unavailable.");
    publishEmergencyEvent("PRIORITY_REJECTED_SERVER_OFFLINE");
    return;
  }

  priorityActive = true;
  lastLcdEvent = "PRIORITY ACTIVATED";
  currentPhase = "PRIORITY_REQUESTED";

  JsonDocument doc;
  doc["device_id"] = DEVICE_ID;
  doc["ambulance_id"] = AMBULANCE_ID;
  doc["emergency_id"] = emergencyId;
  doc["action"] = "PRIORITY_ON";
  doc["priority_active"] = true;
  doc["patient_onboard"] = patientOnBoard;
  doc["source"] = source;

  publishJson(TOPIC_EMERGENCY, doc);

  startBLEBeacon();

  publishEmergencyEvent("PRIORITY_ON");

  Serial.println("[PRIORITY] ON");
}

void deactivatePriority(const char* source) {
  priorityActive = false;
  greenCorridorActive = false;
  currentPhase = patientOnBoard ? "TO_HOSPITAL" : "TO_PATIENT";

  stopBLEBeacon();

  JsonDocument doc;
  doc["device_id"] = DEVICE_ID;
  doc["ambulance_id"] = AMBULANCE_ID;
  doc["emergency_id"] = emergencyId;
  doc["action"] = "PRIORITY_OFF";
  doc["priority_active"] = false;
  doc["source"] = source;

  publishJson(TOPIC_EMERGENCY, doc);
  publishEmergencyEvent("PRIORITY_OFF");
}

// =================================================================
// BUTTONS
// =================================================================

bool pressed(int pin, bool& lastState) {
  bool now = digitalRead(pin);

  bool result = (lastState == HIGH && now == LOW);
  lastState = now;

  return result;
}

void handlePhysicalButtons() {
  if (pressed(ACCEPT_BUTTON, lastAcceptState)) {
    acceptEmergency("PHYSICAL_BUTTON");
  }

  if (pressed(REJECT_BUTTON, lastRejectState)) {
    rejectCurrentEmergency("PHYSICAL_BUTTON");
  }

  if (pressed(PRIORITY_BUTTON, lastPriorityState)) {
    if (!priorityActive) {
      activatePriority("PHYSICAL_BUTTON");
    } else {
      deactivatePriority("PHYSICAL_BUTTON");
    }
  }
}

// =================================================================
// MQTT COMMAND HANDLER
// =================================================================

void handleCommand(JsonDocument& doc) {
  const char* command = doc["command"] | "";

  // Direct local GSM jobs. The backend must resolve all phone numbers.
  if (strcmp(command, "GSM_SEND_SMS") == 0 ||
      strcmp(command, "GSM_CALL") == 0 ||
      strcmp(command, "GSM_HANGUP") == 0) {
    handleLocalGsmCommand(doc, command);
    return;
  }

  // --------------------------------------------------------------
  // NEW EMERGENCY ASSIGNMENT
  // --------------------------------------------------------------
  if (strcmp(command, "EMERGENCY_ASSIGNMENT") == 0) {
    emergencyActive = true;
    emergencyAccepted = false;
    patientOnBoard = false;
    priorityActive = false;
    greenCorridorActive = false;

    // A new assignment always starts without the previous emergency's
    // BLE beacon. The beacon is enabled only after acceptance + priority.
    stopBLEBeacon();

    emergencyId = doc["emergency_id"] | "";
    patientId = doc["patient_id"] | "";
    emergencySource = doc["emergency_source"] | "UNKNOWN";

    patientLat = doc["patient_lat"] | 0.0;
    patientLon = doc["patient_lon"] | 0.0;

    hospitalId = doc["hospital_id"] | "";
    hospitalName = doc["hospital_name"] | "";
    hospitalLat = doc["hospital_lat"] | 0.0;
    hospitalLon = doc["hospital_lon"] | 0.0;

    incomingDirection = doc["incoming_direction"] | "";
    outgoingDirection = doc["outgoing_direction"] | "";

    distanceToPatientM = doc["distance_to_patient_m"] | -1;
    distanceToHospitalM = doc["distance_to_hospital_m"] | -1;
    etaToPatientSec = doc["eta_to_patient_sec"] | -1;
    etaToHospitalSec = doc["eta_to_hospital_sec"] | -1;

    startResponseWindow(1);

    requestCallToServer("NEW_EMERGENCY_ASSIGNMENT");

    requestSmsToServer(
      "AMBULANCE",
      "New emergency assigned. Emergency ID: " + emergencyId
    );

    return;
  }

  // --------------------------------------------------------------
  // DASHBOARD / SERVER ACCEPT
  // --------------------------------------------------------------
  if (strcmp(command, "DASHBOARD_ACCEPT") == 0 ||
      strcmp(command, "SERVER_ACCEPT") == 0) {
    acceptEmergency("DASHBOARD");
    return;
  }

  // --------------------------------------------------------------
  // DASHBOARD / SERVER REJECT
  // --------------------------------------------------------------
  if (strcmp(command, "DASHBOARD_REJECT") == 0 ||
      strcmp(command, "SERVER_REJECT") == 0) {
    rejectCurrentEmergency("DASHBOARD");
    return;
  }

  // --------------------------------------------------------------
  // SERVER REASSIGN
  // --------------------------------------------------------------
  if (strcmp(command, "EMERGENCY_CANCELLED") == 0) {
    currentPhase = "CANCELLED";
    publishEmergencyEvent("EMERGENCY_CANCELLED");
    clearEmergencyData();
    stopBLEBeacon();
    return;
  }

  // --------------------------------------------------------------
  // PATIENT REACHED
  // Backend remains authoritative.
  // --------------------------------------------------------------
  if (strcmp(command, "REACHED_PATIENT_LOCATION") == 0) {
    currentPhase = "REACHED_PATIENT_LOCATION";
    publishEmergencyEvent("REACHED_PATIENT_LOCATION");

    requestSmsToServer(
      "PATIENT",
      "Ambulance reached patient location."
    );

    requestSmsToServer(
      "FAMILY",
      "Ambulance reached patient location."
    );

    requestSmsToServer(
      "HOSPITAL",
      "Ambulance reached patient location."
    );

    return;
  }

  // --------------------------------------------------------------
  // PATIENT PICKUP
  // --------------------------------------------------------------
  if (strcmp(command, "PATIENT_PICKED_UP") == 0) {
    patientOnBoard = true;
    currentPhase = "PATIENT_ONBOARD";

    publishEmergencyEvent("PATIENT_PICKED_UP");

    requestSmsToServer(
      "PATIENT",
      "Patient is onboard ambulance."
    );

    requestSmsToServer(
      "FAMILY",
      "Patient is onboard ambulance."
    );

    requestSmsToServer(
      "HOSPITAL",
      "Patient is onboard ambulance."
    );

    return;
  }

  // --------------------------------------------------------------
  // HOSPITAL SELECTED / READY
  // --------------------------------------------------------------
  if (strcmp(command, "HOSPITAL_SELECTED") == 0) {
    hospitalId = doc["hospital_id"] | hospitalId.c_str();
    hospitalName = doc["hospital_name"] | hospitalName.c_str();
    hospitalLat = doc["hospital_lat"] | hospitalLat;
    hospitalLon = doc["hospital_lon"] | hospitalLon;

    etaToHospitalSec = doc["eta_to_hospital_sec"] | etaToHospitalSec;
    distanceToHospitalM = doc["distance_to_hospital_m"] | distanceToHospitalM;

    currentPhase = "HOSPITAL_SELECTED";

    publishEmergencyEvent("HOSPITAL_SELECTED");
    return;
  }

  if (strcmp(command, "HOSPITAL_READY") == 0) {
    currentPhase = "HOSPITAL_READY";
    publishEmergencyEvent("HOSPITAL_READY");

    requestSmsToServer(
      "HOSPITAL",
      "Hospital is ready for emergency " + emergencyId
    );

    return;
  }

  // --------------------------------------------------------------
  // DASHBOARD PRIORITY
  // --------------------------------------------------------------
  if (strcmp(command, "DASHBOARD_PRIORITY_ON") == 0 ||
      strcmp(command, "SERVER_PRIORITY_ON") == 0) {
    activatePriority("DASHBOARD");
    return;
  }

  if (strcmp(command, "DASHBOARD_PRIORITY_OFF") == 0 ||
      strcmp(command, "SERVER_PRIORITY_OFF") == 0) {
    deactivatePriority("DASHBOARD");
    return;
  }

  // --------------------------------------------------------------
  // GREEN CORRIDOR STATUS FROM BACKEND
  // --------------------------------------------------------------
  if (strcmp(command, "GREEN_CORRIDOR_ACTIVE") == 0) {
    if (priorityActive && patientOnBoard) {
      greenCorridorActive = true;
      currentJunction = doc["junction_id"] | currentJunction.c_str();

      incomingDirection = doc["incoming_direction"] | incomingDirection.c_str();
      outgoingDirection = doc["outgoing_direction"] | outgoingDirection.c_str();

      currentPhase = "GREEN_CORRIDOR";

      publishEmergencyEvent("GREEN_CORRIDOR_ACTIVE");
    }
    return;
  }

  if (strcmp(command, "GREEN_CORRIDOR_STOP") == 0) {
    greenCorridorActive = false;
    currentJunction = doc["junction_id"] | currentJunction.c_str();

    currentPhase = patientOnBoard ? "TO_HOSPITAL" : "TO_PATIENT";

    publishEmergencyEvent("GREEN_CORRIDOR_STOP");
    return;
  }

  // --------------------------------------------------------------
  // JUNCTION UPDATE
  // --------------------------------------------------------------
  if (strcmp(command, "JUNCTION_UPDATE") == 0) {
    currentJunction = doc["junction_id"] | currentJunction.c_str();

    greenCorridorActive = doc["green_corridor_active"] |
                          greenCorridorActive;

    incomingDirection = doc["incoming_direction"] |
                        incomingDirection.c_str();

    outgoingDirection = doc["outgoing_direction"] |
                        outgoingDirection.c_str();

    return;
  }

  // --------------------------------------------------------------
  // ARRIVED AT HOSPITAL
  // --------------------------------------------------------------
  if (strcmp(command, "ARRIVED_AT_HOSPITAL") == 0) {
    currentPhase = "ARRIVED_AT_HOSPITAL";

    priorityActive = false;
    greenCorridorActive = false;

    stopBLEBeacon();

    publishEmergencyEvent("ARRIVED_AT_HOSPITAL");

    requestSmsToServer(
      "PATIENT",
      "Ambulance arrived at hospital."
    );

    requestSmsToServer(
      "FAMILY",
      "Patient ambulance arrived at hospital."
    );

    requestSmsToServer(
      "HOSPITAL",
      "Ambulance arrived at hospital."
    );

    return;
  }

  // --------------------------------------------------------------
  // EMERGENCY COMPLETE
  // --------------------------------------------------------------
  if (strcmp(command, "EMERGENCY_COMPLETED") == 0) {
    currentPhase = "COMPLETED";

    publishEmergencyEvent("EMERGENCY_COMPLETED");

    stopBLEBeacon();

    clearEmergencyData();
    return;
  }

  // --------------------------------------------------------------
  // BACKEND LIVE UPDATE
  // --------------------------------------------------------------
  if (strcmp(command, "LIVE_UPDATE") == 0) {
    etaToPatientSec = doc["eta_to_patient_sec"] | etaToPatientSec;
    etaToHospitalSec = doc["eta_to_hospital_sec"] | etaToHospitalSec;

    distanceToPatientM =
      doc["distance_to_patient_m"] | distanceToPatientM;

    distanceToHospitalM =
      doc["distance_to_hospital_m"] | distanceToHospitalM;

    currentJunction =
      doc["current_junction"] | currentJunction.c_str();

    hospitalName =
      doc["hospital_name"] | hospitalName.c_str();

    hospitalId =
      doc["hospital_id"] | hospitalId.c_str();

    lastSmsStatus =
      doc["last_sms_status"] | lastSmsStatus.c_str();

    lastCallStatus =
      doc["last_call_status"] | lastCallStatus.c_str();

    lastNotificationEvent =
      doc["last_notification_event"] |
      lastNotificationEvent.c_str();

    familySmsSentCount =
      doc["family_sms_sent_count"] | familySmsSentCount;

    patientSmsSentCount =
      doc["patient_sms_sent_count"] | patientSmsSentCount;

    hospitalSmsSentCount =
      doc["hospital_sms_sent_count"] | hospitalSmsSentCount;

    totalSmsSentCount =
      doc["total_sms_sent_count"] | totalSmsSentCount;

    return;
  }
}

// =================================================================
// MQTT CALLBACK
// =================================================================

void mqttCallback(char* topic, byte* payload, unsigned int length) {
  String message;

  for (unsigned int i = 0; i < length; i++) {
    message += (char)payload[i];
  }

  Serial.print("[MQTT] ");
  Serial.print(topic);
  Serial.print(" -> ");
  Serial.println(message);

  JsonDocument doc;
  DeserializationError error = deserializeJson(doc, message);

  if (error) {
    Serial.println("[MQTT] Invalid JSON");
    return;
  }

  handleCommand(doc);
}

// =================================================================
// MQTT CONNECTION
// =================================================================

void connectMQTT() {
  if (WiFi.status() != WL_CONNECTED) return;
  if (mqtt.connected()) return;

  if (millis() - lastMqttRetry < MQTT_RETRY_INTERVAL) return;
  lastMqttRetry = millis();

  // Prefer the latest UDP-discovered backend.
  // If discovery has not arrived for 15 seconds, use the fixed-IP fallback.
  if (medrasServerDiscovered) {
    mqtt.setServer(medrasMQTTServerIP, medrasMQTTServerPort);
    usingFallbackServer = false;
  } else {
    if (discoveryStartMillis == 0) {
      discoveryStartMillis = millis();
    }

    if (millis() - discoveryStartMillis < DISCOVERY_FALLBACK_DELAY) {
      Serial.println("[MQTT] Waiting for MEDRAS server discovery...");
      return;
    }

    mqtt.setServer(MQTT_FALLBACK_SERVER, MQTT_FALLBACK_PORT);
    usingFallbackServer = true;
  }

  String clientId = String("MEDRAS_") + AMBULANCE_ID + "_" +
                    String((uint32_t)ESP.getEfuseMac(), HEX);

  Serial.print("[MQTT] Connecting to ");
  if (usingFallbackServer) {
    Serial.print(MQTT_FALLBACK_SERVER);
    Serial.print(":");
    Serial.print(MQTT_FALLBACK_PORT);
    Serial.print(" [15s FALLBACK] ");
  } else {
    Serial.print(medrasMQTTServerIP);
    Serial.print(":");
    Serial.print(medrasMQTTServerPort);
    Serial.print(" [AUTO-DISCOVERED] ");
  }

  if (mqtt.connect(clientId.c_str())) {
    Serial.println("CONNECTED");

    mqtt.subscribe(TOPIC_COMMAND);

    publishStatus("MQTT_CONNECTED");
  } else {
    Serial.print("FAILED rc=");
    Serial.println(mqtt.state());
  }
}

// =================================================================
// WIFI
// =================================================================

void connectWiFi() {
  if (WiFi.status() == WL_CONNECTED) {
    if (!medrasDiscoveryUdpStarted) {
      if (medrasDiscoveryUDP.begin(4210)) {
        medrasDiscoveryUdpStarted = true;
        discoveryStartMillis = millis();
        Serial.println("[UDP] MEDRAS discovery listening on port 4210");
      } else {
        Serial.println("[UDP] Failed to start discovery listener; will retry");
      }
    }
    return;
  }

  if (millis() - lastWifiRetry < WIFI_RETRY_INTERVAL) return;
  lastWifiRetry = millis();

  Serial.println("[WiFi] Connecting...");

  WiFi.mode(WIFI_STA);
  WiFi.begin(WIFI_SSID, WIFI_PASS);
}

// =================================================================
// RESPONSE TIMEOUT
// =================================================================

void handleResponseCountdown() {
  if (!responseWindowActive) return;

  unsigned long now = millis();

  if (now >= responseDeadline) {
    responseWindowActive = false;

    if (assignmentAttempt < MAX_ASSIGNMENT_ATTEMPTS) {
      // Second 10-second window for THE SAME ambulance.
      startResponseWindow(assignmentAttempt + 1);
    } else {
      // Backend chooses the next nearest ambulance.
      currentPhase = "REASSIGN_REQUESTED";

      JsonDocument doc;
      doc["device_id"] = DEVICE_ID;
      doc["ambulance_id"] = AMBULANCE_ID;
      doc["emergency_id"] = emergencyId;
      doc["event"] = "NO_RESPONSE_AFTER_TWO_WINDOWS";
      doc["request"] = "FIND_NEXT_NEAREST_AMBULANCE";

      publishJson(TOPIC_EMERGENCY, doc);

      requestCallToServer("NO_RESPONSE_AFTER_TWO_WINDOWS");

      currentPhase = "WAITING_REASSIGNMENT";

      lcdPage = 0;
    }
  }
}

// =================================================================
// BUZZER ALERT
// =================================================================

void handleAlertBuzzer() {
  if (!emergencyActive || emergencyAccepted || !responseWindowActive) {
    buzzerOff();
    return;
  }

  if (millis() - lastAlertBeep >= ALERT_BEEP_INTERVAL) {
    lastAlertBeep = millis();

    if (digitalRead(BUZZER_PIN) == HIGH) {
      buzzerOff();
    } else {
      buzzerOn();
    }
  }
}

// =================================================================
// LCD
// =================================================================

String countdownText() {
  if (!responseWindowActive) return "--";

  unsigned long remaining =
    (responseDeadline > millis())
      ? responseDeadline - millis()
      : 0;

  return String((remaining + 999) / 1000);
}

String shortEta(long seconds) {
  if (seconds < 0) return "--";
  if (seconds < 60) return String(seconds) + "s";

  long min = seconds / 60;
  long sec = seconds % 60;

  return String(min) + "m" + String(sec) + "s";
}

void printLcdLine(uint8_t row, String text) {
  if (text.length() > 16) text = text.substring(0, 16);
  lcd.setCursor(0, row);
  lcd.print(text);
  for (int i = text.length(); i < 16; ++i) lcd.print(' ');
}

String compactStatus(String value) {
  value.replace("AMBULANCE_", "AMB_");
  value.replace("PRIORITY_", "PRIO_");
  value.replace("EMERGENCY_", "EMG_");
  value.replace(" ", "_");
  return value;
}

void updateLCD() {
  if (millis() - lastLcdUpdate < LCD_INTERVAL) return;
  lastLcdUpdate = millis();

  // A 16x2 LCD cannot show every field simultaneously, so it rotates
  // through concise status pages. An active 10-second response window
  // always takes priority so the driver can see the remaining time.
  if (responseWindowActive) {
    printLcdLine(0, "EMG " + emergencyId.substring(0, min(11, (int)emergencyId.length())));
    printLcdLine(1, "RESP " + countdownText() + "s A" + String(assignmentAttempt) + " ACCEPT/REJ");
    return;
  }

  switch (lcdPage) {
    case 0: {
      printLcdLine(0, "MEDRAS AMB_001");
      String state = emergencyActive ? (emergencyAccepted ? "ACCEPTED" : currentPhase) : "READY";
      printLcdLine(1, state);
      break;
    }
    case 1: {
      bool wifiOk = WiFi.status() == WL_CONNECTED;
      printLcdLine(0, wifiOk ? "WIFI CONNECTED" : "WIFI DISCONNECTED");
      if (wifiOk) printLcdLine(1, WiFi.localIP().toString());
      else printLcdLine(1, "CHECK HOTSPOT");
      break;
    }
    case 2: {
      printLcdLine(0, mqtt.connected() ? "MQTT CONNECTED" : "MQTT DISCONNECTED");
      printLcdLine(1, mqtt.connected() ? medrasMQTTServerIP.toString() : "SERVER/BROKER ERR");
      break;
    }
    case 3: {
      printLcdLine(0, gpsFix ? "GPS FIX: VALID" : "GPS: NO FIX YET");
      printLcdLine(1, "SAT:" + String((unsigned int)satellites) + " SPD:" + String((int)speedKmph) + "km/h");
      break;
    }
    case 4: {
      if (gpsFix) {
        printLcdLine(0, String("LAT ") + String(latitude, 4));
        printLcdLine(1, String("LON ") + String(longitude, 4));
      } else {
        printLcdLine(0, "GPS WAITING OUTDOOR");
        printLcdLine(1, "CHECK TX16/RX17");
      }
      break;
    }
    case 5: {
      // Status page for the SIM900A connected directly to ambulance ESP32 #1.
      printLcdLine(0, localGsmReady ? "GSM: READY" : "GSM: NOT READY");
      if (localGsmCallActive) {
        printLcdLine(1, "CALL: DIALING");
      } else {
        printLcdLine(1, compactStatus(localGsmLastResult));
      }
      break;
    }
    case 6: {
      printLcdLine(0, "EVENT:");
      printLcdLine(1, compactStatus(lastLcdEvent));
      break;
    }
    case 7: {
      printLcdLine(0, emergencyAccepted ? "EMERGENCY ACCEPTED" : (currentPhase == "REJECTED" ? "EMERGENCY REJECTED" : "ACCEPT / REJECT"));
      printLcdLine(1, emergencyActive ? emergencyId.substring(0, 16) : "NO ACTIVE EMERGENCY");
      break;
    }
    case 8: {
      printLcdLine(0, priorityActive ? "PRIORITY: ACTIVE" : "PRIORITY: OFF");
      printLcdLine(1, patientOnBoard ? "PATIENT ONBOARD" : "PATIENT NOT ONBOARD");
      break;
    }
    case 9: {
      printLcdLine(0, "CALL:" + compactStatus(lastCallStatus));
      printLcdLine(1, "SMS:" + compactStatus(lastSmsStatus));
      break;
    }
    default: {
      printLcdLine(0, greenCorridorActive ? "GREEN CORRIDOR ON" : "TRAFFIC: NORMAL");
      printLcdLine(1, "SMS COUNT:" + String(totalSmsSentCount));
      break;
    }
  }

  lcdPage++;
  if (lcdPage > 10) lcdPage = 0;
}

// =================================================================
// SETUP
// =================================================================

void setup() {
  Serial.begin(115200);

  // UDP discovery is initialized only after Wi-Fi connects in connectWiFi().
  // Starting WiFiUDP before WiFi is initialized can trigger a FreeRTOS assertion.

  // GPIO32 supports INPUT_PULLUP; connect accept button between GPIO32 and GND.
  pinMode(ACCEPT_BUTTON, INPUT_PULLUP);
  pinMode(REJECT_BUTTON, INPUT_PULLUP);
  pinMode(PRIORITY_BUTTON, INPUT_PULLUP);

  pinMode(BUZZER_PIN, OUTPUT);
  buzzerOff();

  Wire.begin(LCD_SDA, LCD_SCL);

  lcd.init();
  lcd.backlight();

  lcd.clear();
  lcd.setCursor(0, 0);
  lcd.print("MEDRAS AMB_001");
  lcd.setCursor(0, 1);
  lcd.print("STARTING...");

  GPSSerial.begin(9600, SERIAL_8N1, GPS_RX, GPS_TX);
  initializeLocalGsm();

  mqtt.setServer(medrasMQTTServerIP, medrasMQTTServerPort);
  mqtt.setCallback(mqttCallback);

  WiFi.mode(WIFI_STA);
  WiFi.begin(WIFI_SSID, WIFI_PASS);

  delay(500);

  lcd.clear();
  lcd.setCursor(0, 0);
  lcd.print("AMB_001 READY");
  lcd.setCursor(0, 1);
  lcd.print("WIFI/GPS STATUS");

  Serial.println();
  Serial.println("==========================================");
  Serial.println(" MEDRAS AMBULANCE CONTROLLER");
  Serial.println(" ESP32 #1 / AMB_001");
  Serial.println("==========================================");
  Serial.println("MQTT : AUTO-DISCOVERY / 15s FALLBACK");
  Serial.print("Fallback MQTT: ");
  Serial.print(MQTT_FALLBACK_SERVER);
  Serial.print(":");
  Serial.println(MQTT_FALLBACK_PORT);
  Serial.println("GPS  : RX16 TX17");
  Serial.println("GSM  : local SIM900A on ESP32 #1, UART1 RX27/TX26");
  Serial.print("GSM status: "); Serial.println(localGsmLastResult);
  Serial.println("PHONE NUMBERS: backend database only");
  Serial.println("LCD  : SDA21 SCL22");
  Serial.println("ACCEPT: GPIO32 (internal pull-up; button to GND)");
  Serial.println("REJECT: GPIO33");
  Serial.println("PRIORITY: GPIO25");
  Serial.println("BUZZER: GPIO4");
  Serial.println("==========================================");
}

// =================================================================
// LOOP
// =================================================================

void loop() {
  medrasDiscoveryTask();
  medrasTransportTask();

  if (localGsmCallActive && millis() - localGsmCallStartedAt >= LOCAL_GSM_CALL_LIMIT_MS) {
    localGsmHangup("20S_LIMIT");
  }

  // 1. Continuously decode GPS first so every following message can
  //    contain the newest available ambulance position.
  readGPS();

  // 2. Maintain network connections before MQTT telemetry/commands.
  connectWiFi();
  connectMQTT();

  if (mqtt.connected()) {
    mqtt.loop();
  }

  handlePhysicalButtons();
  handleResponseCountdown();
  handleAlertBuzzer();
  updateLCD();

  // Exactly one live telemetry publication per second. This data is
  // consumed by the backend and then shown on the live dashboards.
  if (millis() - lastLivePublish >= LIVE_INTERVAL) {
    lastLivePublish = millis();
    publishLiveData();
  }

  // Refresh BLE state.
  if (millis() - lastBleRefresh >= BLE_REFRESH_INTERVAL) {
    lastBleRefresh = millis();

    if (priorityActive && patientOnBoard && emergencyActive) {
      startBLEBeacon();
    } else {
      stopBLEBeacon();
    }
  }
}
